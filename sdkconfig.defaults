## sdkconfig.defaults
```kconfig
# ==================== 编译器配置 ====================
# 启用大小优化编译
CONFIG_COMPILER_OPTIMIZATION_SIZE=y
# 启用 C++ 异常处理
CONFIG_COMPILER_CXX_EXCEPTIONS=y
# C++ 异常处理紧急池大小
CONFIG_COMPILER_CXX_EXCEPTIONS_EMG_POOL_SIZE=1024
# 启用 C++ RTTI (运行时类型信息)
CONFIG_COMPILER_CXX_RTTI=y

# ==================== 引导加载程序配置 ====================
# 引导加载程序使用性能优化编译
CONFIG_BOOTLOADER_COMPILER_OPTIMIZATION_PERF=y
# 引导加载程序日志级别设置为无
CONFIG_BOOTLOADER_LOG_LEVEL_NONE=y
# 始终跳过应用程序验证
CONFIG_BOOTLOADER_SKIP_VALIDATE_ALWAYS=y
# 启用应用程序回滚功能
CONFIG_BOOTLOADER_APP_ROLLBACK_ENABLE=y

# ==================== HTTP 服务器配置 ====================
# HTTP 请求头最大长度
CONFIG_HTTPD_MAX_REQ_HDR_LEN=2048
# HTTP URI 最大长度
CONFIG_HTTPD_MAX_URI_LEN=2048

# ==================== 分区表配置 ====================
# 使用自定义分区表
CONFIG_PARTITION_TABLE_CUSTOM=y
# 自定义分区表文件路径
CONFIG_PARTITION_TABLE_CUSTOM_FILENAME="partitions/v2/16m.csv"
# 分区表偏移地址
CONFIG_PARTITION_TABLE_OFFSET=0x8000

# ==================== 系统配置 ====================
# ESP 任务看门狗超时时间（秒）
CONFIG_ESP_TASK_WDT_TIMEOUT_S=10
# 启用 FreeRTOS 运行时统计
CONFIG_FREERTOS_GENERATE_RUN_TIME_STATS=y
# 使用 FreeRTOS 统计格式化函数
CONFIG_FREERTOS_USE_STATS_FORMATTING_FUNCTIONS=y

# ==================== 内存配置 ====================
# ESP 主任务栈大小
CONFIG_ESP_MAIN_TASK_STACK_SIZE=8192
# 启用 mbedTLS 动态缓冲区
CONFIG_MBEDTLS_DYNAMIC_BUFFER=y
# 禁用 mbedTLS SSL 保留对等证书
CONFIG_MBEDTLS_SSL_KEEP_PEER_CERTIFICATE=n
# 禁用 WiFi IRAM 优化
CONFIG_ESP_WIFI_IRAM_OPT=n
# 禁用 WiFi RX IRAM 优化
CONFIG_ESP_WIFI_RX_IRAM_OPT=n
# 启用 WiFi 动态 RX 管理缓冲区
CONFIG_ESP_WIFI_DYNAMIC_RX_MGMT_BUFFER=y

# ==================== WiFi 配置 ====================
# 这些配置来自 ESP-HI (ESP32C3) 以减少内存使用
# WiFi 静态 RX 缓冲区数量
CONFIG_ESP_WIFI_STATIC_RX_BUFFER_NUM=6
# WiFi 动态 RX 缓冲区数量
CONFIG_ESP_WIFI_DYNAMIC_RX_BUFFER_NUM=8
# 使用 newlib nano 格式
CONFIG_NEWLIB_NANO_FORMAT=y
# 禁用 WiFi 企业级支持
CONFIG_ESP_WIFI_ENTERPRISE_SUPPORT=n

# ==================== UART 配置 ====================
# 修复 ML307 FIFO 溢出问题
# 启用 UART ISR 在 IRAM 中运行
CONFIG_UART_ISR_IN_IRAM=y

# ==================== SSL 配置 ====================
# 修复 ESP_SSL 错误
# 禁用 mbedTLS SSL 重新协商
CONFIG_MBEDTLS_SSL_RENEGOTIATION=n

# FreeRTOS 时钟频率(提高定时器精度)
CONFIG_FREERTOS_HZ=1000

# LVGL 操作系统集成
CONFIG_LV_OS_FREERTOS=y

# 使用标准 C 库函数
CONFIG_LV_USE_CLIB_MALLOC=y
CONFIG_LV_USE_CLIB_STRING=y
CONFIG_LV_USE_CLIB_SPRINTF=y

# 自定义字体 bin 按 LVGL --large 格式生成(16 字节 glyph 描述符),必须开启
CONFIG_LV_FONT_FMT_TXT_LARGE=y

# 显示刷新率(单位:毫秒,15ms ≈ 66 FPS)
CONFIG_LV_DEF_REFR_PERIOD=15

# 启用样式缓存以提高性能
CONFIG_LV_OBJ_STYLE_CACHE=y
```

## sdkconfig.defaults.esp32s3
```kconfig
# ==================== ESP32S3 特定配置 ====================

# ==================== Flash 配置 ====================
# 设置 Flash 大小为 16MB
CONFIG_ESPTOOLPY_FLASHSIZE_16MB=y
# 设置 Flash 模式为 QIO (四线输入输出)
CONFIG_ESPTOOLPY_FLASHMODE_QIO=y

# ==================== CPU 配置 ====================
# 设置默认 CPU 频率为 240MHz
CONFIG_ESP_DEFAULT_CPU_FREQ_MHZ_240=y

# ==================== 外部 RAM 配置 ====================
# 启用外部 SPI RAM
CONFIG_SPIRAM=y
# 设置 SPI RAM 模式为八线模式
CONFIG_SPIRAM_MODE_OCT=y
# 设置 SPI RAM 速度为 80MHz
CONFIG_SPIRAM_SPEED_80M=y
# SPI RAM 分配始终内部使用的大小 (字节)
CONFIG_SPIRAM_MALLOC_ALWAYSINTERNAL=512
# SPI RAM 分配保留内部内存的大小 (字节)
CONFIG_SPIRAM_MALLOC_RESERVE_INTERNAL=65536
# 禁用 SPI RAM 内存测试
CONFIG_SPIRAM_MEMTEST=n
# 启用 mbedTLS 外部内存分配
CONFIG_MBEDTLS_EXTERNAL_MEM_ALLOC=y

# ==================== WiFi 配置 ====================
# WiFi 静态 RX 缓冲区数量
CONFIG_ESP_WIFI_STATIC_RX_BUFFER_NUM=3
# WiFi 动态 RX 缓冲区数量
CONFIG_ESP_WIFI_DYNAMIC_RX_BUFFER_NUM=6
# WiFi RX 块确认窗口大小
CONFIG_ESP_WIFI_RX_BA_WIN=3
# LWIP TCP/IP 接收邮箱大小
CONFIG_LWIP_TCPIP_RECVMBOX_SIZE=16
# 启用 mbedTLS 动态释放配置数据
CONFIG_MBEDTLS_DYNAMIC_FREE_CONFIG_DATA=y

# ==================== 缓存配置 ====================
# 设置 ESP32S3 指令缓存大小为 32KB
CONFIG_ESP32S3_INSTRUCTION_CACHE_32KB=y
# 设置 ESP32S3 数据缓存行大小为 64B
CONFIG_ESP32S3_DATA_CACHE_LINE_64B=y

# ==================== TTS 配置 ====================
# 启用 SR_WN_WN9_NIHAOXIAOZHI_TTS
CONFIG_SR_WN_WN9_NIHAOXIAOZHI_TTS=y

# ==================== 系统配置 ====================
# ESP 系统事件任务栈大小
CONFIG_ESP_SYSTEM_EVENT_TASK_STACK_SIZE=4096

# ==================== USB 配置 ====================
# USB 主机控制传输最大大小
CONFIG_USB_HOST_CONTROL_TRANSFER_MAX_SIZE=1536

# ==================== LVGL 图形配置 ====================
# 启用 LVGL 快照功能
CONFIG_LV_USE_SNAPSHOT=y

# 自定义分区表文件路径 覆盖 skdconfig.defaults skdconfig
CONFIG_PARTITION_TABLE_CUSTOM_FILENAME="partitions/16m.csv"
```
